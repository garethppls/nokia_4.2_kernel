/* Copyright (c) 2018, The Linux Foundation. All rights reserved.
 *
 * This program is free software; you can redistribute it and/or modify
 * it under the terms of the GNU General Public License version 2 and
 * only version 2 as published by the Free Software Foundation.
 *
 * This program is distributed in the hope that it will be useful,
 * but WITHOUT ANY WARRANTY; without even the implied warranty of
 * MERCHANTABILITY or FITNESS FOR A PARTICULAR PURPOSE.  See the
 * GNU General Public License for more details.
 */

&mdss_mdp {
	dsi_hx8394f_720p_txd_vid: qcom,mdss_dsi_hx8394f_720p_txd_video{
		qcom,mdss-dsi-panel-name =
			"hx8394f video mode dsi txd panel";
		qcom,mdss-dsi-panel-type = "dsi_video_mode";
		qcom,mdss-dsi-panel-framerate = <60>;
		qcom,mdss-dsi-virtual-channel-id = <0>;
		qcom,mdss-dsi-stream = <0>;
		qcom,mdss-dsi-panel-width = <720>;
		qcom,mdss-dsi-panel-height = <1520>;
		qcom,mdss-dsi-h-front-porch = <16>;
		qcom,mdss-dsi-h-back-porch = <16>;
		qcom,mdss-dsi-h-pulse-width = <10>;
		qcom,mdss-dsi-h-sync-skew = <0>;
		qcom,mdss-dsi-v-back-porch = <12>;
		qcom,mdss-dsi-v-front-porch = <15>;
		qcom,mdss-dsi-v-pulse-width = <4>;
		qcom,mdss-dsi-h-left-border = <0>;
		qcom,mdss-dsi-h-right-border = <0>;
		qcom,mdss-dsi-v-top-border = <0>;
		qcom,mdss-dsi-v-bottom-border = <0>;
		qcom,mdss-pan-physical-width-dimension = <65>;
		qcom,mdss-pan-physical-height-dimension = <129>;
		qcom,mdss-dsi-bpp = <24>;
		qcom,mdss-dsi-color-order = "rgb_swap_rgb";
		qcom,mdss-dsi-underflow-color = <0xff>;
		qcom,mdss-dsi-border-color = <0>;
		qcom,mdss-dsi-on-command = [39 01 00 00 00 00 04 B9 FF 83 94
		39 01 00 00 00 00 07 BA 63 03 68 6B B2 C0
		39 01 00 00 00 00 0B B1 48 16 76 09 32 54 71 51 57 43
		39 01 00 00 00 00 07 B2 00 80 78 0C 0D 22
		39 01 00 00 00 00 16 B4 69 6A 69 6A 69 6A 01 0C 7C 55 00 3F 69 6A 69 6A 69 6A 01 0C 7C
		39 01 00 00 00 00 03 B6 6E 6E
		39 01 00 00 00 00 02 D2 99
		39 01 00 00 00 00 22 D3 00 00 07 07 40 07 0C 00 08 10 08 00 08 54 15 AA 05 AA 02 15 06 05 06 47 44 0A 0A 4B 10 07 07 0C 40
		39 01 00 00 00 00 2D D5 1C 1C 1D 1D 00 01 02 03 04 05 06 07 08 09 0A 0B 24 25 18 18 26 27 18 18 18 18 18 18 18 18 18 18 18 18 18 18 18 18 20 21 18 18 18 18
		39 01 00 00 00 00 2D D6 1C 1C 1D 1D 0B 0A 09 08 07 06 05 04 03 02 01 00 21 20 18 18 27 26 18 18 18 18 18 18 18 18 18 18 18 18 18 18 18 18 25 24 18 18 18 18
		39 01 00 00 00 00 3B E0 00 03 08 0D 0F 12 16 14 29 39 49 47 4E 5D 60 63 70 74 71 81 92 49 47 4B 4E 51 55 58 7F 00 03 08 0D 0F 12 16 14 29 39 49 47 4D 5D 5F 62 6F 72 70 81 93 49 48 4B 4E 51 56 59 7F
		39 01 00 00 00 00 03 C0 1F 31
		39 01 00 00 00 00 02 CC 0B
		39 01 00 00 00 00 02 D4 02
		39 01 00 00 00 00 02 BD 02
		39 01 00 00 00 00 0D D8 FF FF FF FF FF FF FF FF FF FF FF FF
		39 01 00 00 00 00 02 BD 00
		39 01 00 00 00 00 02 BD 01
		39 01 00 00 00 00 02 B1 00
		39 01 00 00 00 00 02 BD 00
		39 01 00 00 00 00 02 C6 ED
		39 01 00 00 05 00 08 C9 0B 01 AA 1E B1 1E 00
		39 01 00 00 05 00 02 55 00
		39 01 00 00 00 00 02 53 2C
		05 01 00 00 78 00 02 11 00
		05 01 00 00 14 00 02 29 00];

		qcom,mdss-dsi-off-command = [05 01 00 00 78 00 02 28 00
				05 01 00 00 96 00 02 10 00];
		qcom,mdss-dsi-on-command-state = "dsi_lp_mode";
		qcom,mdss-dsi-off-command-state = "dsi_hs_mode";
		qcom,mdss-dsi-h-sync-pulse = <1>;
		qcom,mdss-dsi-traffic-mode = "burst_mode";
		qcom,mdss-dsi-lane-map = "lane_map_0123";
		qcom,mdss-dsi-bllp-eof-power-mode;
		qcom,mdss-dsi-bllp-power-mode;
		qcom,mdss-dsi-tx-eot-append;
		qcom,mdss-dsi-lane-0-state;
		qcom,mdss-dsi-lane-1-state;
		qcom,mdss-dsi-lane-2-state;
		qcom,mdss-dsi-lane-3-state;
		qcom,mdss-dsi-panel-timings
			= [72 16 0e 00 38 3c 12 1a 10 03 04 00];
		qcom,mdss-dsi-t-clk-post = <0x04>;
		qcom,mdss-dsi-t-clk-pre = <0x18>;
		qcom,mdss-dsi-dma-trigger = "trigger_sw";
		qcom,mdss-dsi-mdp-trigger = "none";
		qcom,mdss-dsi-lp11-init;
		qcom,mdss-dsi-reset-sequence = <1 10>, <0 10>, <1 10>;
	};
};
