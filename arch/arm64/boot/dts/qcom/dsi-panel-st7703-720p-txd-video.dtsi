/* Copyright (c) 2018, The Linux Foundation. All rights reserved.
 *
 * This program is free software; you can redistribute it and/or modify
 * it under the terms of the GNU General Public License version 2 and
 * only version 2 as published by the Free Software Foundation.
 *
 * This program is distributed in the hope that it will be useful,
 * but WITHOUT ANY WARRANTY; without even the implied warranty of
 * MERCHANTABILITY or FITNESS FOR A PARTICULAR PURPOSE.  See the
 * GNU General Public License for more details.
*		qcom,mdss-dsi-h-pulse-width = <10>;
*		qcom,mdss-dsi-h-sync-skew = <0>;
*		qcom,mdss-dsi-v-back-porch = <11>;
*		qcom,mdss-dsi-v-front-porch = <17>;
*		qcom,mdss-dsi-v-pulse-width = <4>;
*		qcom,mdss-dsi-h-left-border = <0>;
*		qcom,mdss-dsi-h-right-border = <0>;
*		qcom,mdss-dsi-v-top-border = <0>;
*		qcom,mdss-dsi-v-bottom-border = <0>;
*		qcom,mdss-pan-physical-width-dimension = <68>;
*		qcom,mdss-pan-physical-height-dimension = <144>;
*/

&mdss_mdp {
	dsi_st7703_720p_txd_vid: qcom,mdss_dsi_st7703_720p_txd_video{
		qcom,mdss-dsi-panel-name =
			"st7703 video mode dsi txd panel";
		qcom,mdss-dsi-panel-type = "dsi_video_mode";
		qcom,mdss-dsi-panel-framerate = <60>;
		qcom,mdss-dsi-virtual-channel-id = <0>;
		qcom,mdss-dsi-stream = <0>;
		qcom,mdss-dsi-panel-width = <720>;
		qcom,mdss-dsi-panel-height = <1520>;
		qcom,mdss-dsi-h-front-porch = <192>;
		qcom,mdss-dsi-h-back-porch = <192>;
		qcom,mdss-dsi-h-pulse-width = <20>;
		qcom,mdss-dsi-h-sync-skew = <0>;
		qcom,mdss-dsi-v-back-porch = <10>;
		qcom,mdss-dsi-v-front-porch = <16>;
		qcom,mdss-dsi-v-pulse-width = <3>;
		qcom,mdss-dsi-h-left-border = <0>;
		qcom,mdss-dsi-h-right-border = <0>;
		qcom,mdss-dsi-v-top-border = <0>;
		qcom,mdss-dsi-v-bottom-border = <0>;
		qcom,mdss-pan-physical-width-dimension = <65>;
		qcom,mdss-pan-physical-height-dimension = <129>;
		qcom,mdss-dsi-bpp = <24>;
		qcom,mdss-dsi-color-order = "rgb_swap_rgb";
		qcom,mdss-dsi-underflow-color = <0xff>;
		qcom,mdss-dsi-border-color = <0>;
		qcom,mdss-dsi-on-command = [39 01 00 00 00 00 04 B9 F1 12 83
39 01 00 00 00 00 1C BA 33 81 05 F9 0E 0E 20 00 00 00 00 00 00 00 44 25 00 91 0A 00 00 02 4F 01 03 02 37
39 01 00 00 00 00 05 B8 76 22 20 03
39 01 00 00 00 00 0B B3 0C 10 05 05 03 FF 00 00 00 00
39 01 00 00 00 00 0A C0 73 73 50 50 A0 00 08 50 00
39 01 00 00 00 00 02 BC 4F
39 01 00 00 00 00 02 CC 0B
39 01 00 00 00 00 02 B4 80
39 01 00 00 00 00 02 B1 85
39 01 00 00 00 00 04 B2 04 12 F0
39 01 00 00 00 00 0F E3 03 03 03 03 03 03 00 00 00 00 2F 80 C0 10
39 01 00 00 00 00 0D C1 54 C0 2A 2A 99 D1 FF FF AE AE 7F 7F
39 01 00 00 00 00 07 C6 01 00 FF FF 00 20
39 01 00 00 00 00 03 B5 11 11
39 01 00 00 00 00 03 B6 43 43
39 01 00 00 00 00 04 BF 02 11 00
39 01 00 00 00 00 40 E9 02 00 0B 06 00 80 81 12 31 23 5F 0E 30 B1 37 0A 00 80 02 00 00 00 00 80 02 00 00 00 84 F0 24 68 88 88 88 80 88 88 88 85 F1 35 78 88 88 88 81 88 88 88 00 00 00 00 00 00 00 00 00 00 00 00 00
39 01 00 00 00 00 3E EA 00 1A 00 00 00 00 02 00 00 00 00 00 F1 87 53 18 88 88 88 85 88 88 88 F0 86 42 08 88 88 88 84 88 88 88 23 20 00 00 24 00 00 00 00 00 00 00 00 00 00 00 00 00 00 00 50 80 81 00 00 00 00
39 01 00 00 00 00 23 E0 00 0B 12 31 3D 3F 48 40 07 0D 0E 11 13 11 12 12 18 00 0B 12 31 3D 3F 48 40 07 0D 0E 11 13 11 12 12 18
39 01 00 00 00 00 23 CD 07 80 82 84 83 81 82 7F 7D 7F 7E 7E 80 81 81 82 83 81 7F 7E 7C 7C 7D 7E 7C 78 78 76 73 76 78 75 79 78
39 01 00 00 00 00 22 CE 80 82 84 83 81 82 7F 7D 7F 7E 7E 80 81 81 82 83 81 7F 7E 7C 7C 7D 7E 7C 78 78 76 73 76 78 75 79 78
39 01 00 00 00 00 22 CF 80 82 84 83 81 82 7F 7D 7F 7E 7E 80 81 81 82 83 81 7F 7E 7C 7C 7D 7E 7C 78 78 76 73 76 78 75 79 78

		05 01 00 00 78 00 02 11 00   //FA
		05 01 00 00 14 00 02 29 00];
		qcom,mdss-dsi-off-command = [05 01 00 00 78 00 02 28 00
				05 01 00 00 96 00 02 10 00];
		qcom,mdss-dsi-on-command-state = "dsi_lp_mode";
		qcom,mdss-dsi-off-command-state = "dsi_hs_mode";
		qcom,mdss-dsi-h-sync-pulse = <1>;
		qcom,mdss-dsi-traffic-mode = "burst_mode";
		qcom,mdss-dsi-lane-map = "lane_map_0123";
		qcom,mdss-dsi-bllp-eof-power-mode;
		qcom,mdss-dsi-bllp-power-mode;
		qcom,mdss-dsi-tx-eot-append;
		qcom,mdss-dsi-lane-0-state;
		qcom,mdss-dsi-lane-1-state;
		qcom,mdss-dsi-lane-2-state;
		qcom,mdss-dsi-lane-3-state;
		qcom,mdss-dsi-panel-timings-phy-12nm = [0e 00 08 06 0c 04 04 0a];
		qcom,mdss-dsi-t-clk-post = <0x04>;
		qcom,mdss-dsi-t-clk-pre = <0x18>;
		qcom,mdss-dsi-dma-trigger = "trigger_sw";
		qcom,mdss-dsi-mdp-trigger = "none";
		qcom,mdss-dsi-lp11-init;
		qcom,mdss-dsi-reset-sequence = <1 5>, <0 5>, <1 50>;
	};
};
