/* Copyright (c) 2018, The Linux Foundation. All rights reserved.
 *
 * This program is free software; you can redistribute it and/or modify
 * it under the terms of the GNU General Public License version 2 and
 * only version 2 as published by the Free Software Foundation.
 *
 * This program is distributed in the hope that it will be useful,
 * but WITHOUT ANY WARRANTY; without even the implied warranty of
 * MERCHANTABILITY or FITNESS FOR A PARTICULAR PURPOSE.  See the
 * GNU General Public License for more details.
 */

&mdss_mdp {
	dsi_jd9365z_720p_huashi_vid: qcom,mdss_dsi_jd9365z_720p_huashi_video{
		qcom,mdss-dsi-panel-name =
			"jd9365z video mode dsi huashi panel";
		qcom,mdss-dsi-panel-type = "dsi_video_mode";
		qcom,mdss-dsi-panel-framerate = <60>;
		qcom,mdss-dsi-virtual-channel-id = <0>;
		qcom,mdss-dsi-stream = <0>;
		qcom,mdss-dsi-panel-width = <720>;
		qcom,mdss-dsi-panel-height = <1520>;
		qcom,mdss-dsi-h-front-porch = <200>;
		qcom,mdss-dsi-h-back-porch = <192>;
		qcom,mdss-dsi-h-pulse-width = <8>;
		qcom,mdss-dsi-h-sync-skew = <0>;
		qcom,mdss-dsi-v-back-porch = <12>;
		qcom,mdss-dsi-v-front-porch = <18>;
		qcom,mdss-dsi-v-pulse-width = <4>;
		qcom,mdss-dsi-h-left-border = <0>;
		qcom,mdss-dsi-h-right-border = <0>;
		qcom,mdss-dsi-v-top-border = <0>;
		qcom,mdss-dsi-v-bottom-border = <0>;
		qcom,mdss-pan-physical-width-dimension = <65>;
		qcom,mdss-pan-physical-height-dimension = <129>;
		qcom,mdss-dsi-bpp = <24>;
		qcom,mdss-dsi-color-order = "rgb_swap_rgb";
		qcom,mdss-dsi-underflow-color = <0xff>;
		qcom,mdss-dsi-border-color = <0>;
		qcom,mdss-dsi-on-command = [39 01 00 00 00 00 04  DF  93 65 F8 
		39 01 00 00 00 00 03  B2  00 7C 
		39 01 00 00 00 00 03  B3  00 89 
		39 01 00 00 00 00 07  B7  00 DF 00 00 DF 00 
		39 01 00 00 00 00 05  B9  00 04 23 07 
		39 01 00 00 00 00 0C  BB  0F 01 24 00 1F 25 28 04 BB CC CC 
		39 01 00 00 00 00 03  BE  1E F2 
		39 01 00 00 00 00 03  C0  78 04 
		39 01 00 00 00 00 03  C1  00 12 
		39 01 00 00 00 00 07  C3  04 02 0A 69 02 6A 
		39 01 00 00 00 00 07  C4  24 F8 B4 6E 12 0F 
		39 01 00 00 00 00 27  C8  7F 73 69 60 60 53 59 43 5A 56 52 68 53 5A 4B 45 38 28 1A 7F 73 69 60 60 53 59 43 5A 56 52 68 53 5A 4B 45 38 28 1A 
		39 01 00 00 00 00 17  D0  41 5F 5F 5F 49 4B 45 47 43 5F 5F 5F 5F 5F 5F 5F 5F 5F 5F 5F 5E 5E 
		39 01 00 00 00 00 17  D1  40 5F 5F 5F 48 4A 44 46 42 5F 5F 5F 5F 5F 5F 5F 5F 5F 5F 5F 5E 5E 
		39 01 00 00 00 00 17  D2  02 1F 1F 1F 06 04 0A 08 00 1F 1E 5F 1F 1F 1F 1F 1F 1F 1F 1F 5E 1F 
		39 01 00 00 00 00 17  D3  03 1F 1F 1F 07 05 0B 09 01 1F 1E 5F 1F 1F 1F 1F 1F 1F 1F 1F 5E 1F 
		39 01 00 00 00 00 17  D4  00 00 00 0C 07 30 01 02 00 54 56 28 30 03 04 00 5A 73 09 0C 58 08 
		39 01 00 00 00 00 18  D5  50 0F 3F 04 30 00 00 00 00 00 BC 50 00 65 C1 00 40 0A 04 00 00 00 60 
		39 01 00 00 00 00 02  DE  02 
		39 01 00 00 00 00 05  B7  0B 01 00 15 
		39 01 00 00 00 00 03  BB  21 22 
                39 01 00 00 00 00 02  DE  03 
                39 01 00 00 00 00 02  D3  77 
		39 01 00 00 00 00 02  DE  00 
 		05 01 00 00 78 00 02  11  00
		05 01 00 00 14 00 02  29  00
];	

		qcom,mdss-dsi-off-command = [05 01 00 00 78 00 02 28 00
				05 01 00 00 96 00 02 10 00];
		qcom,mdss-dsi-on-command-state = "dsi_lp_mode";
		qcom,mdss-dsi-off-command-state = "dsi_hs_mode";
		qcom,mdss-dsi-h-sync-pulse = <1>;
		qcom,mdss-dsi-traffic-mode = "burst_mode";
		qcom,mdss-dsi-lane-map = "lane_map_0123";
		qcom,mdss-dsi-bllp-eof-power-mode;
		qcom,mdss-dsi-bllp-power-mode;
		qcom,mdss-dsi-tx-eot-append;
		qcom,mdss-dsi-lane-0-state;
		qcom,mdss-dsi-lane-1-state;
		qcom,mdss-dsi-lane-2-state;
		qcom,mdss-dsi-lane-3-state;
		qcom,mdss-dsi-panel-timings
			= [df 1c 12 00 42 44 18 20 17 03 04 00];
		qcom,mdss-dsi-t-clk-post = <0x04>;
		qcom,mdss-dsi-t-clk-pre = <0x18>;
		qcom,mdss-dsi-dma-trigger = "trigger_sw";
		qcom,mdss-dsi-mdp-trigger = "none";
		qcom,mdss-dsi-lp11-init;
		qcom,mdss-dsi-reset-sequence = <1 10>, <0 10>, <1 60>;
	};
};
