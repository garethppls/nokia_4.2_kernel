/* Copyright (c) 2018, The Linux Foundation. All rights reserved.
 *
 * This program is free software; you can redistribute it and/or modify
 * it under the terms of the GNU General Public License version 2 and
 * only version 2 as published by the Free Software Foundation.
 *
 * This program is distributed in the hope that it will be useful,
 * but WITHOUT ANY WARRANTY; without even the implied warranty of
 * MERCHANTABILITY or FITNESS FOR A PARTICULAR PURPOSE.  See the
 * GNU General Public License for more details.
 */

&mdss_mdp {
	dsi_ili9881d_720_led_vid: qcom,mdss_dsi_ili9881d_720p_led_video{
		qcom,mdss-dsi-panel-name =
			"ili9881d video mode dsi led panel";
		qcom,mdss-dsi-panel-type = "dsi_video_mode";
		qcom,mdss-dsi-panel-framerate = <60>;
		qcom,mdss-dsi-virtual-channel-id = <0>;
		qcom,mdss-dsi-stream = <0>;
		qcom,mdss-dsi-panel-width = <720>;
		qcom,mdss-dsi-panel-height = <1520>;
		qcom,mdss-dsi-h-front-porch = <180>;
		qcom,mdss-dsi-h-back-porch = <180>;
		qcom,mdss-dsi-h-pulse-width = <12>;
		qcom,mdss-dsi-h-sync-skew = <0>;
		qcom,mdss-dsi-v-back-porch = <14>;
		qcom,mdss-dsi-v-front-porch = <18>;
		qcom,mdss-dsi-v-pulse-width = <8>;
		qcom,mdss-dsi-h-left-border = <0>;
		qcom,mdss-dsi-h-right-border = <0>;
		qcom,mdss-dsi-v-top-border = <0>;
		qcom,mdss-dsi-v-bottom-border = <0>;
		qcom,mdss-pan-physical-width-dimension = <65>;
		qcom,mdss-pan-physical-height-dimension = <129>;
		qcom,mdss-dsi-bpp = <24>;
		qcom,mdss-dsi-color-order = "rgb_swap_rgb";
		qcom,mdss-dsi-underflow-color = <0xff>;
		qcom,mdss-dsi-border-color = <0>;
		qcom,mdss-dsi-on-command = [39 01 00 00 00 00 04 FF 98 81 03  
		39 01 00 00 00 00 02 01 00 
		39 01 00 00 00 00 02 02 00 
		39 01 00 00 00 00 02 03 73 
		39 01 00 00 00 00 02 04 13 
		39 01 00 00 00 00 02 05 00 
		39 01 00 00 00 00 02 06 0a 
		39 01 00 00 00 00 02 07 05 
		39 01 00 00 00 00 02 08 00 
		39 01 00 00 00 00 02 09 00 
		39 01 00 00 00 00 02 0a 00 
		39 01 00 00 00 00 02 0b 00 
		39 01 00 00 00 00 02 0c 0b 
		39 01 00 00 00 00 02 0d 00 
		39 01 00 00 00 00 02 0e 00 
		39 01 00 00 00 00 02 0f 1b 
		39 01 00 00 00 00 02 10 1b 
		39 01 00 00 00 00 02 11 00 
		39 01 00 00 00 00 02 12 00 
		39 01 00 00 00 00 02 13 02 
		39 01 00 00 00 00 02 14 00 
		39 01 00 00 00 00 02 15 08 
		39 01 00 00 00 00 02 16 08 
		39 01 00 00 00 00 02 17 00 
		39 01 00 00 00 00 02 18 08 
		39 01 00 00 00 00 02 19 00 
		39 01 00 00 00 00 02 1a 00 
		39 01 00 00 00 00 02 1b 00 
		39 01 00 00 00 00 02 1c 00 
		39 01 00 00 00 00 02 1d 00 
		39 01 00 00 00 00 02 1e 40 
		39 01 00 00 00 00 02 1f C0 
		39 01 00 00 00 00 02 20 06 
		39 01 00 00 00 00 02 21 01 
		39 01 00 00 00 00 02 22 00 
		39 01 00 00 00 00 02 23 00 
		39 01 00 00 00 00 02 24 00 
		39 01 00 00 00 00 02 25 00 
		39 01 00 00 00 00 02 26 00 
		39 01 00 00 00 00 02 27 00 
		39 01 00 00 00 00 02 28 B3 
		39 01 00 00 00 00 02 29 03 
		39 01 00 00 00 00 02 2a 80 
		39 01 00 00 00 00 02 2b 00 
		39 01 00 00 00 00 02 2c 0b 
		39 01 00 00 00 00 02 2d 01 
		39 01 00 00 00 00 02 2e 0a 
		39 01 00 00 00 00 02 2f 00 
		39 01 00 00 00 00 02 30 00 
		39 01 00 00 00 00 02 31 00 
		39 01 00 00 00 00 02 32 30 
		39 01 00 00 00 00 02 33 02 
		39 01 00 00 00 00 02 34 a3 
		39 01 00 00 00 00 02 35 0a 
		39 01 00 00 00 00 02 36 03 
		39 01 00 00 00 00 02 37 00 
		39 01 00 00 00 00 02 38 00 
		39 01 00 00 00 00 02 39 35 
		39 01 00 00 00 00 02 3a 01 
		39 01 00 00 00 00 02 3b 40 
		39 01 00 00 00 00 02 3c 00 
		39 01 00 00 00 00 02 3d 01 
		39 01 00 00 00 00 02 3e 00 
		39 01 00 00 00 00 02 3f 00 
		39 01 00 00 00 00 02 40 35 
		39 01 00 00 00 00 02 41 88 
		39 01 00 00 00 00 02 42 00 
		39 01 00 00 00 00 02 43 40 
		39 01 00 00 00 00 02 44 3f 
		39 01 00 00 00 00 02 45 20 
		39 01 00 00 00 00 02 46 00  
		39 01 00 00 00 00 02 50 01
		39 01 00 00 00 00 02 51 23 
		39 01 00 00 00 00 02 52 44 
		39 01 00 00 00 00 02 53 67 
		39 01 00 00 00 00 02 54 89 
		39 01 00 00 00 00 02 55 ab 
		39 01 00 00 00 00 02 56 01 
		39 01 00 00 00 00 02 57 23 
		39 01 00 00 00 00 02 58 45 
		39 01 00 00 00 00 02 59 67 
		39 01 00 00 00 00 02 5a 89 
		39 01 00 00 00 00 02 5b ab 
		39 01 00 00 00 00 02 5c cd 
		39 01 00 00 00 00 02 5d ef 
		39 01 00 00 00 00 02 5e 11 
		39 01 00 00 00 00 02 5f 00 
		39 01 00 00 00 00 02 60 00 
		39 01 00 00 00 00 02 61 01 
		39 01 00 00 00 00 02 62 01 
		39 01 00 00 00 00 02 63 17 
		39 01 00 00 00 00 02 64 17 
		39 01 00 00 00 00 02 65 02 
		39 01 00 00 00 00 02 66 02 
		39 01 00 00 00 00 02 67 02 
		39 01 00 00 00 00 02 68 08 
		39 01 00 00 00 00 02 69 16 
		39 01 00 00 00 00 02 6a 16 
		39 01 00 00 00 00 02 6b 0e 
		39 01 00 00 00 00 02 6c 0e 
		39 01 00 00 00 00 02 6d 0f 
		39 01 00 00 00 00 02 6e 0f 
		39 01 00 00 00 00 02 6f 0c
		39 01 00 00 00 00 02 70 0c
		39 01 00 00 00 00 02 71 0d
		39 01 00 00 00 00 02 72 0d
		39 01 00 00 00 00 02 73 06
		39 01 00 00 00 00 02 74 07
		39 01 00 00 00 00 02 75 00
		39 01 00 00 00 00 02 76 00
		39 01 00 00 00 00 02 77 01
		39 01 00 00 00 00 02 78 01
		39 01 00 00 00 00 02 79 17
		39 01 00 00 00 00 02 7a 17
		39 01 00 00 00 00 02 7b 02
		39 01 00 00 00 00 02 7c 02
		39 01 00 00 00 00 02 7d 02
		39 01 00 00 00 00 02 7e 08
		39 01 00 00 00 00 02 7f 16
		39 01 00 00 00 00 02 80 16
		39 01 00 00 00 00 02 81 0e
		39 01 00 00 00 00 02 82 0e
		39 01 00 00 00 00 02 83 0f
		39 01 00 00 00 00 02 84 0f
		39 01 00 00 00 00 02 85 0c
		39 01 00 00 00 00 02 86 0c
		39 01 00 00 00 00 02 87 0d
		39 01 00 00 00 00 02 88 0d
		39 01 00 00 00 00 02 89 06
		39 01 00 00 00 00 02 8A 07
		39 01 00 00 00 00 04 FF 98 81 04 
		39 01 00 00 00 00 02 68 db
		39 01 00 00 00 00 02 70 00
		39 01 00 00 00 00 02 71 00
		39 01 00 00 00 00 02 66 1e
		39 01 00 00 00 00 02 82 09
		39 01 00 00 00 00 02 84 09
		39 01 00 00 00 00 02 85 14
		39 01 00 00 00 00 02 32 ac
		39 01 00 00 00 00 02 8c 80
		39 01 00 00 00 00 02 3c f5
		39 01 00 00 00 00 02 3a 24
		39 01 00 00 00 00 02 b5 02
		39 01 00 00 00 00 02 31 25
		39 01 00 00 00 00 02 88 33 
		39 01 00 00 00 00 04 FF 98 81 01 
		39 01 00 00 00 00 02 22 0A
		39 01 00 00 00 00 02 31 00
		39 01 00 00 00 00 02 50 8b
		39 01 00 00 00 00 02 51 8b
		39 01 00 00 00 00 02 53 6b
		39 01 00 00 00 00 02 55 77 
		39 01 00 00 00 00 02 60 2b
		39 01 00 00 00 00 02 61 00 
		39 01 00 00 00 00 02 62 19 
		39 01 00 00 00 00 02 63 00 
		39 01 00 00 00 00 02 2E 04
		39 01 00 00 00 00 02 F6 01 
		39 01 00 00 00 00 02 2F 00
		39 01 00 00 00 00 02 A0 08
		39 01 00 00 00 00 02 A1 14
		39 01 00 00 00 00 02 A2 1f
		39 01 00 00 00 00 02 A3 14
		39 01 00 00 00 00 02 A4 12
		39 01 00 00 00 00 02 A5 24
		39 01 00 00 00 00 02 A6 19
		39 01 00 00 00 00 02 A7 1c
		39 01 00 00 00 00 02 A8 72
		39 01 00 00 00 00 02 A9 1B
		39 01 00 00 00 00 02 AA 27
		39 01 00 00 00 00 02 AB 6c
		39 01 00 00 00 00 02 AC 1e
		39 01 00 00 00 00 02 AD 1f
		39 01 00 00 00 00 02 AE 53
		39 01 00 00 00 00 02 AF 27
		39 01 00 00 00 00 02 B0 2b
		39 01 00 00 00 00 02 B1 51
		39 01 00 00 00 00 02 B2 5f
		39 01 00 00 00 00 02 B3 32
		39 01 00 00 00 00 02 C0 08
		39 01 00 00 00 00 02 C1 14
		39 01 00 00 00 00 02 C2 1f
		39 01 00 00 00 00 02 C3 14
		39 01 00 00 00 00 02 C4 12
		39 01 00 00 00 00 02 C5 24
		39 01 00 00 00 00 02 C6 19
		39 01 00 00 00 00 02 C7 1c
		39 01 00 00 00 00 02 C8 72
		39 01 00 00 00 00 02 C9 1b
		39 01 00 00 00 00 02 CA 27
		39 01 00 00 00 00 02 CB 6c
		39 01 00 00 00 00 02 CC 1e
		39 01 00 00 00 00 02 CD 1f
		39 01 00 00 00 00 02 CE 53
		39 01 00 00 00 00 02 CF 27
		39 01 00 00 00 00 02 D0 2b
		39 01 00 00 00 00 02 D1 51
		39 01 00 00 00 00 02 D2 5f
		39 01 00 00 00 00 02 D3 32
		39 01 00 00 00 00 04 FF 98 81 00 
		39 01 00 00 00 00 02 35 00 
		05 01 00 00 78 00 02 11 00
		05 01 00 00 14 00 02 29 00];

		qcom,mdss-dsi-off-command = [05 01 00 00 78 00 02 28 00
				05 01 00 00 96 00 02 10 00];
		qcom,mdss-dsi-on-command-state = "dsi_lp_mode";
		qcom,mdss-dsi-off-command-state = "dsi_hs_mode";
		qcom,mdss-dsi-h-sync-pulse = <1>;
		qcom,mdss-dsi-traffic-mode = "burst_mode";
		qcom,mdss-dsi-lane-map = "lane_map_0123";
		qcom,mdss-dsi-bllp-eof-power-mode;
		qcom,mdss-dsi-bllp-power-mode;
		qcom,mdss-dsi-tx-eot-append;
		qcom,mdss-dsi-lane-0-state;
		qcom,mdss-dsi-lane-1-state;
		qcom,mdss-dsi-lane-2-state;
		qcom,mdss-dsi-lane-3-state;
		qcom,mdss-dsi-t-clk-post = <0x04>;
		qcom,mdss-dsi-t-clk-pre = <0x18>;
		qcom,mdss-dsi-dma-trigger = "trigger_sw";
		qcom,mdss-dsi-mdp-trigger = "none";
		qcom,mdss-dsi-lp11-init;
		qcom,mdss-dsi-reset-sequence = <1 10>, <0 10>, <1 10>;
	};
};
