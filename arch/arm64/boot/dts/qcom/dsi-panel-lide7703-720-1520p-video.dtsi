/*
 * Copyright (c) 2015-2016, The Linux Foundation. All rights reserved.
 *
 * This program is free software; you can redistribute it and/or modify
 * it under the terms of the GNU General Public License version 2 and
 * only version 2 as published by the Free Software Foundation.
 *
 * This program is distributed in the hope that it will be useful,
 * but WITHOUT ANY WARRANTY; without even the implied warranty of
 * MERCHANTABILITY or FITNESS FOR A PARTICULAR PURPOSE.  See the
 * GNU General Public License for more details.
 */

/*---------------------------------------------------------------------------
 * This file is autogenerated file using gcdb parser. Please do not edit it.
 * Update input XML file to add a new entry or update variable in this file
 * VERSION = "1.0"
 *---------------------------------------------------------------------------*/
&mdss_mdp {
	dsi_lide7703_720_1520p_video: qcom,mdss_dsi_lide7703_720_1520p_video {
		qcom,mdss-dsi-panel-name = "lide7703 720 1520p video mode dsi panel";
		qcom,mdss-dsi-panel-type = "dsi_video_mode";
		qcom,mdss-dsi-panel-destination = "display_1";
		qcom,mdss-dsi-panel-framerate = <60>;
		qcom,mdss-dsi-virtual-channel-id = <0>;
		qcom,mdss-dsi-stream = <0>;
		qcom,mdss-dsi-panel-width = <720>;
		qcom,mdss-dsi-panel-height = <1520>;
		qcom,mdss-dsi-h-front-porch = <40>;
		qcom,mdss-dsi-h-back-porch = <40>;
		qcom,mdss-dsi-h-pulse-width = <10>;
		qcom,mdss-dsi-h-sync-skew = <0>;
		qcom,mdss-dsi-v-back-porch = <11>;
		qcom,mdss-dsi-v-front-porch = <17>;
		qcom,mdss-dsi-v-pulse-width = <4>;
		qcom,mdss-dsi-h-left-border = <0>;
		qcom,mdss-dsi-h-right-border = <0>;
		qcom,mdss-dsi-v-top-border = <0>;
		qcom,mdss-dsi-v-bottom-border = <0>;
		qcom,mdss-pan-physical-width-dimension = <65>;
		qcom,mdss-pan-physical-height-dimension = <129>;
		qcom,mdss-dsi-bpp = <24>;
		qcom,mdss-dsi-underflow-color = <0xff>;
		qcom,mdss-dsi-border-color = <0>;
		qcom,mdss-dsi-on-command = [
39 01 00 00 00 00 04 B9 F1 12 83
39 01 00 00 00 00 1C BA 33 81 05 F9 0E 0E 20 00 00 00 00 00 00 00 44 25 00 91 0A 00 00 02 4F 01 7F 7F 37
39 01 00 00 00 00 02 B8 76
39 01 00 00 00 00 04 BF 02 11 00
39 01 00 00 00 00 0B B3 0C 10 0A 50 03 FF 00 00 00 00
39 01 00 00 00 00 0A C0 73 73 50 50 90 00 08 60 00
39 01 00 00 00 00 02 BC 46
39 01 00 00 00 00 02 CC 0B
39 01 00 00 00 00 02 B4 80
39 01 00 00 00 00 02 B1 85
39 01 00 00 00 00 04 B2 04 12 F0
39 01 00 00 00 00 0F E3 07 07 0B 0B 03 0B 00 00 00 00 FF 80 C0 10
39 01 00 00 00 00 0D C1 54 00 32 32 77 F1 DD DD AA AA 77 77
39 01 00 00 00 00 07 C6 01 00 FF FF 00 20
39 01 00 00 00 00 03 B5 10 10
39 01 00 00 00 00 03 B6 60 60
39 01 00 00 00 00 40 E9 C2 10 05 00 00 80 81 12 31 23 2F 83 80 81 27 0A 04 00 00 00 00 00 04 00 00 00 00 00 BA 64 20 88 88 88 88 88 88 08 88 BA 75 31 88 88 88 88 88 88 18 88 00 00 00 01 00 00 00 00 00 00 00 00 00
39 01 00 00 00 00 3E EA 97 0C 82 02 0D 06 00 00 00 00 00 00 57 13 81 88 88 88 88 88 88 BA 88 46 02 80 88 88 88 88 88 88 BA 88 23 10 00 00 0F 00 00 00 00 00 00 00 00 00 00 00 00 00 00 00 00 00 00 00 00 00 00
39 01 00 00 00 00 23 E0 00 09 0F 26 2C 3F 41 35 08 0C 0D 11 12 10 10 11 18 00 09 0F 26 2C 3F 41 35 08 0C 0D 11 12 10 10 11 18
05 01 00 00 7B 00 02 11 00
05 01 00 00 14 00 02 29 00];
		qcom,mdss-dsi-off-command = [05 01 00 00 32 00 02 28 00
				 05 01 00 00 96 00 02 10 00];
		qcom,mdss-dsi-on-command-state = "dsi_lp_mode";
		qcom,mdss-dsi-off-command-state = "dsi_lp_mode";
		qcom,mdss-dsi-h-sync-pulse = <0>;
		qcom,mdss-dsi-traffic-mode = "non_burst_sync_event";
		qcom,mdss-dsi-lane-map = "lane_map_0123";
		qcom,mdss-dsi-bllp-eof-power-mode;
		qcom,mdss-dsi-bllp-power-mode;
		qcom,mdss-dsi-tx-eot-append;
		qcom,mdss-dsi-lane-0-state;
		qcom,mdss-dsi-lane-1-state;
		qcom,mdss-dsi-lane-2-state;
		qcom,mdss-dsi-lane-3-state;
		qcom,mdss-dsi-lp11-init;
		qcom,mdss-dsi-panel-timings = [87 1c 12 00 42 42 18 20 17 03 04 00];
		qcom,mdss-dsi-t-clk-post = <0x04>;
		qcom,mdss-dsi-t-clk-pre = <0x1B>;
		//qcom,mdss-dsi-bl-min-level = <41>;//1
		//qcom,mdss-dsi-bl-max-level = <4095>;
		qcom,mdss-dsi-dma-trigger = "trigger_sw";
		qcom,mdss-dsi-mdp-trigger = "none";
		qcom,mdss-dsi-bl-pmic-control-type = "bl_ctrl_pwm";
		qcom,mdss-dsi-bl-pmic-pwm-frequency = <500>;
		qcom,mdss-dsi-bl-pmic-bank-select = <0>;
		qcom,mdss-dsi-reset-sequence = <1 20>, <0 20>, <1 60>;
	};
};
