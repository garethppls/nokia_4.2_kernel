/*
 * Copyright (c) 2015-2016, The Linux Foundation. All rights reserved.
 *
 * This program is free software; you can redistribute it and/or modify
 * it under the terms of the GNU General Public License version 2 and
 * only version 2 as published by the Free Software Foundation.
 *
 * This program is distributed in the hope that it will be useful,
 * but WITHOUT ANY WARRANTY; without even the implied warranty of
 * MERCHANTABILITY or FITNESS FOR A PARTICULAR PURPOSE.  See the
 * GNU General Public License for more details.
 */

/*---------------------------------------------------------------------------
 * This file is autogenerated file using gcdb parser. Please do not edit it.
 * Update input XML file to add a new entry or update variable in this file
 * VERSION = "1.0"
 *---------------------------------------------------------------------------*/
&mdss_mdp {
	dsi_ili9881d_720_1520p_video: qcom,mdss_dsi_ili9881d_720_1520p_video {
		qcom,mdss-dsi-panel-name = "ili9881d 720 1520p video mode dsi panel";
		qcom,mdss-dsi-panel-type = "dsi_video_mode";
		qcom,mdss-dsi-panel-destination = "display_1";
		qcom,mdss-dsi-panel-framerate = <60>;
		qcom,mdss-dsi-virtual-channel-id = <0>;
		qcom,mdss-dsi-stream = <0>;
		qcom,mdss-dsi-panel-width = <720>;
		qcom,mdss-dsi-panel-height = <1520>;
		qcom,mdss-dsi-h-front-porch = <58>;//88
		qcom,mdss-dsi-h-back-porch = <100>;//120
		qcom,mdss-dsi-h-pulse-width = <8>;
		qcom,mdss-dsi-h-sync-skew = <0>;
		qcom,mdss-dsi-v-back-porch = <24>;
		qcom,mdss-dsi-v-front-porch = <16>;
		qcom,mdss-dsi-v-pulse-width = <8>;
		qcom,mdss-dsi-h-left-border = <0>;
		qcom,mdss-dsi-h-right-border = <0>;
		qcom,mdss-dsi-v-top-border = <0>;
		qcom,mdss-dsi-v-bottom-border = <0>;
		qcom,mdss-pan-physical-width-dimension = <65>;
		qcom,mdss-pan-physical-height-dimension = <129>;
		qcom,mdss-dsi-bpp = <24>;
		qcom,mdss-dsi-underflow-color = <0xff>;
		qcom,mdss-dsi-border-color = <0>;
		qcom,mdss-dsi-on-command = [
         	39 01 00 00 00 00 04 FF 98 81 01                                                  
		29 01 00 00 00 00 02 91 00                    
		29 01 00 00 00 00 02 92 00                    
		29 01 00 00 00 00 02 93 56                    
		29 01 00 00 00 00 02 94 13                    
		29 01 00 00 00 00 02 95 00                    
		29 01 00 00 00 00 02 96 06                    
		29 01 00 00 00 00 02 97 01                    
		29 01 00 00 00 00 02 98 00        
		/////////////////    GIP fine tune //////////////          
		29 01 00 00 00 00 02 09 00
		29 01 00 00 00 00 02 0a 03    //00
		29 01 00 00 00 00 02 0b 03    //00
		29 01 00 00 00 00 02 0c 00
		29 01 00 00 00 00 02 0d 00
		29 01 00 00 00 00 02 0e 00
		29 01 00 00 00 00 02 0f 00    //08
		29 01 00 00 00 00 02 10 00    //08 
		29 01 00 00 00 00 02 11 00
		29 01 00 00 00 00 02 12 00
		29 01 00 00 00 00 02 13 00
		29 01 00 00 00 00 02 14 00
		29 01 00 00 00 00 02 15 08    //GPM
		29 01 00 00 00 00 02 16 08    //GPM 
		29 01 00 00 00 00 02 17 00 
		29 01 00 00 00 00 02 18 08    //00
		29 01 00 00 00 00 02 19 00
		29 01 00 00 00 00 02 1a 00
		29 01 00 00 00 00 02 1b 00
		29 01 00 00 00 00 02 1c 00
		29 01 00 00 00 00 02 1d 00
		29 01 00 00 00 00 02 1e C4
		29 01 00 00 00 00 02 1f 00
		29 01 00 00 00 00 02 20 00
		29 01 00 00 00 00 02 21 01
		29 01 00 00 00 00 02 22 01
		29 01 00 00 00 00 02 23 00
		29 01 00 00 00 00 02 24 8A
		29 01 00 00 00 00 02 25 8A
		29 01 00 00 00 00 02 26 8A
		29 01 00 00 00 00 02 27 8A
		29 01 00 00 00 00 02 28 3b
		29 01 00 00 00 00 02 29 11
		29 01 00 00 00 00 02 2a 00
		29 01 00 00 00 00 02 2b 00
		29 01 00 00 00 00 02 2c 00
		29 01 00 00 00 00 02 2d 00
		29 01 00 00 00 00 02 2e 00
		29 01 00 00 00 00 02 2f 00
		29 01 00 00 00 00 02 30 00
		29 01 00 00 00 00 02 31 00
		29 01 00 00 00 00 02 32 00
		29 01 00 00 00 00 02 33 00
		29 01 00 00 00 00 02 34 00
		29 01 00 00 00 00 02 35 00
		29 01 00 00 00 00 02 36 00
		29 01 00 00 00 00 02 37 00
		29 01 00 00 00 00 02 38 00               
		29 01 00 00 00 00 02 39 07                    
		29 01 00 00 00 00 02 3a 00                    
		29 01 00 00 00 00 02 3b 00                    
		29 01 00 00 00 00 02 3c 00                                                
		29 01 00 00 00 00 02 40 03                    
		29 01 00 00 00 00 02 41 20                    
		29 01 00 00 00 00 02 42 00                    
		29 01 00 00 00 00 02 43 00                    
		29 01 00 00 00 00 02 44 03                    
		29 01 00 00 00 00 02 45 00                    
		29 01 00 00 00 00 02 46 01                    
		29 01 00 00 00 00 02 47 08                    
		29 01 00 00 00 00 02 48 00                    
		29 01 00 00 00 00 02 49 00                    
		29 01 00 00 00 00 02 4a 00                    
		29 01 00 00 00 00 02 4b 00                                                   
		// ==== GL_BW[7:4][3:0]====                    
		29 01 00 00 00 00 02 4c 17                    
		29 01 00 00 00 00 02 4d 20                    
		29 01 00 00 00 00 02 4e 75                    
		29 01 00 00 00 00 02 4f B9                    
		29 01 00 00 00 00 02 50 2B                    
		29 01 00 00 00 00 02 51 22                    
		29 01 00 00 00 00 02 52 22                    
		29 01 00 00 00 00 02 53 22                    
		29 01 00 00 00 00 02 54 22                    
		29 01 00 00 00 00 02 55 22                    
		29 01 00 00 00 00 02 56 22                                                         
		// ==== GR_BW[7:4][3:0]==                    
		29 01 00 00 00 00 02 57 16                    
		29 01 00 00 00 00 02 58 20                    
		29 01 00 00 00 00 02 59 64                    
		29 01 00 00 00 00 02 5a A8                    
		29 01 00 00 00 00 02 5b 2A                    
		29 01 00 00 00 00 02 5c 22                    
		29 01 00 00 00 00 02 5d 22                    
		29 01 00 00 00 00 02 5e 22                    
		29 01 00 00 00 00 02 5f 22                    
		29 01 00 00 00 00 02 60 22                    
		29 01 00 00 00 00 02 61 22                                                        
		29 01 00 00 00 00 02 62 06                                                         
		//== GL_BW[5:4] ; GL_FW[5:0]==           
		29 01 00 00 00 00 02 63 0A    
		29 01 00 00 00 00 02 64 01                    
		29 01 00 00 00 00 02 65 00                    
		29 01 00 00 00 00 02 66 02                    
		29 01 00 00 00 00 02 67 5A                    
		29 01 00 00 00 00 02 68 58                    
		29 01 00 00 00 00 02 69 56                    
		29 01 00 00 00 00 02 6a 54                    
		29 01 00 00 00 00 02 6b 06                    
		29 01 00 00 00 00 02 6c 02                    
		29 01 00 00 00 00 02 6d 02                    
		29 01 00 00 00 00 02 6e 02                    
		29 01 00 00 00 00 02 6f 02                    
		29 01 00 00 00 00 02 70 02                    
		29 01 00 00 00 00 02 71 02                    
		29 01 00 00 00 00 02 72 02                    
		29 01 00 00 00 00 02 73 02                    
		29 01 00 00 00 00 02 74 02                    
		29 01 00 00 00 00 02 75 02                    
		29 01 00 00 00 00 02 76 02                    
		29 01 00 00 00 00 02 77 02                    
		29 01 00 00 00 00 02 78 02                                                        
		//== GR_BW[5:4] ; GR_FW[5:0]==           
		29 01 00 00 00 00 02 79 0B                    
		29 01 00 00 00 00 02 7a 01                    
		29 01 00 00 00 00 02 7b 00                    
		29 01 00 00 00 00 02 7c 02                    
		29 01 00 00 00 00 02 7d 5B                    
		29 01 00 00 00 00 02 7e 59                    
		29 01 00 00 00 00 02 7f 57                    
		29 01 00 00 00 00 02 80 55                    
		29 01 00 00 00 00 02 81 07                    
		29 01 00 00 00 00 02 82 02                    
		29 01 00 00 00 00 02 83 02                    
		29 01 00 00 00 00 02 84 02                    
		29 01 00 00 00 00 02 85 02                    
		29 01 00 00 00 00 02 86 02                    
		29 01 00 00 00 00 02 87 02                    
		29 01 00 00 00 00 02 88 02                    
		29 01 00 00 00 00 02 89 02                    
		29 01 00 00 00 00 02 8a 02                    
		29 01 00 00 00 00 02 8b 02                    
		29 01 00 00 00 00 02 8c 02                    
		29 01 00 00 00 00 02 8d 02                    
		29 01 00 00 00 00 02 8e 02                    
		29 01 00 00 00 00 02 a0 35                    
		29 01 00 00 00 00 02 a1 01                    
		29 01 00 00 00 00 02 a2 00                    
		29 01 00 00 00 00 02 a3 00                    
		29 01 00 00 00 00 02 a4 00                    
		29 01 00 00 00 00 02 a5 10                    
		29 01 00 00 00 00 02 a6 08                    
		29 01 00 00 00 00 02 a7 00                    
		29 01 00 00 00 00 02 a8 00                    
		29 01 00 00 00 00 02 a9 00                    
		29 01 00 00 00 00 02 aa 00                    
		29 01 00 00 00 00 02 ab 00                    
		29 01 00 00 00 00 02 ac 00                    
		29 01 00 00 00 00 02 ad 00                    
		29 01 00 00 00 00 02 ae ff                    
		29 01 00 00 00 00 02 af 00                    
		29 01 00 00 00 00 02 b0 00    
		//================GIP code finish ================//                                  
		39 01 00 00 00 00 04 FF 98 81 02              
		29 01 00 00 00 00 02 42 12    //SDT=1.2us                                                      
		39 01 00 00 00 00 15 A0 00 1D 2D 16 1C 30 25 24 95 1B 27 77 1B 1C 51 26 2B 4D 58 21
		39 01 00 00 00 00 15 C0 00 1D 2D 16 1C 30 25 24 95 1B 27 77 1B 1C 51 26 2B 4D 58 21
		29 01 00 00 00 00 02 18 F4        // SH on   default E4 
		////=======================================/////////
		39 01 00 00 00 00 04 FF 98 81 04
		29 01 00 00 00 00 02 00 00     //3lane 
		29 01 00 00 00 00 02 5D 83     //VREG1 5V 
		29 01 00 00 00 00 02 5E 83     //VREG2 5V
		29 01 00 00 00 00 02 60 4A     //VCM1 
		29 01 00 00 00 00 02 62 4A     //VCM2  
		29 01 00 00 00 00 02 82 40     //VREF_VGH_MOD_CLPSEL 16V 
		29 01 00 00 00 00 02 84 40     //VREF_VGH_DC 16V     
		29 01 00 00 00 00 02 86 28     //VREF_VGL_CLPSEL -12V       
		//=================AB new add===============//
		29 01 00 00 00 00 02 5B 33     //  vcore_sel Voltage
		29 01 00 00 00 00 02 6C 10     //  vcore bias L
		29 01 00 00 00 00 02 77 03     //  vcore_sel Voltage
		29 01 00 00 00 00 02 7B 02     //  vcore bias R
		////=======================================/////     
		39 01 00 00 00 00 04 FF 98 81 01                                
		29 01 00 00 00 00 02 F0 01     //1520 Gate NL          
		29 01 00 00 00 00 02 F1 04     //1520 Gate NL      
		39 01 00 00 00 00 04 FF 98 81 05
		29 01 00 00 00 00 02 22 32    //SS
		39 01 00 00 00 00 04 FF 98 81 00     
		29 01 00 00 00 00 02 35 00           
		05 01 00 00 78 00 02 11 00     
		05 01 00 00 96 00 02 29 00];
		qcom,mdss-dsi-off-command = [
		05 01 00 00 32 00 02 28 00
		05 01 00 00 96 00 02 10 00];
		qcom,mdss-dsi-on-command-state = "dsi_lp_mode";
		qcom,mdss-dsi-off-command-state = "dsi_lp_mode";
		qcom,mdss-dsi-h-sync-pulse = <0>;
		qcom,mdss-dsi-traffic-mode = "non_burst_sync_event";
		//qcom,mdss-dsi-lane-map = "lane_map_0123";
		qcom,mdss-dsi-lane-map = "lane_map_012";
		qcom,mdss-dsi-bllp-eof-power-mode;
		qcom,mdss-dsi-bllp-power-mode;
		qcom,mdss-dsi-tx-eot-append;
		qcom,mdss-dsi-lane-0-state;
		qcom,mdss-dsi-lane-1-state;
		qcom,mdss-dsi-lane-2-state;
		//qcom,mdss-dsi-lane-3-state;
		qcom,mdss-dsi-lp11-init;
		//qcom,mdss-dsi-panel-timings = [8b 1e 14 00 44 48 18 22 19 03 04 00];
		qcom,mdss-dsi-panel-timings = [99 2a 1c 00 54 58 20 2e 23 03 04 00];
		qcom,mdss-dsi-t-clk-post = <0x03>;
		qcom,mdss-dsi-t-clk-pre = <0x20>;
		//qcom,mdss-dsi-bl-min-level = <10>;//1
		//qcom,mdss-dsi-bl-max-level = <1023>;
		qcom,mdss-dsi-dma-trigger = "trigger_sw";
		qcom,mdss-dsi-mdp-trigger = "none";
		qcom,mdss-dsi-bl-pmic-control-type = "bl_ctrl_pwm";
		qcom,mdss-dsi-bl-pmic-pwm-frequency = <500>;
		qcom,mdss-dsi-bl-pmic-bank-select = <0>;
		qcom,mdss-dsi-reset-sequence = <1 5>, <0 5>, <1 60>;
	};
};
