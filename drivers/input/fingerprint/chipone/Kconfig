## drivers/input/fingerprint/chipone/Kconfig
```kconfig
config CHIPONE_FINGERPRINT
        tristate "Chipone Finger Print Driver"
		default y
        help
          Chipone Finger Print Supported
```

## drivers/input/fingerprint/sunwave/Kconfig
```kconfig
config SUNWAVE_FINGERPRINT
       tristate "Sunwave Fingerprint"
       default y
       help
          SUNWAVECORP Fingerprint
```
